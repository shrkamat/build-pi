## conf/bblayers.conf
```bitbake
# POKY_BBLAYERS_CONF_VERSION is increased each time build/conf/bblayers.conf
# changes incompatibly
POKY_BBLAYERS_CONF_VERSION = "2"

BBPATH = "${TOPDIR}"
BBFILES ?= ""

BBLAYERS ?= " \
  /home/shrkamat/work/rpi_test/poky/meta \
  /home/shrkamat/work/rpi_test/poky/meta-poky \
  /home/shrkamat/work/rpi_test/poky/meta-yocto-bsp \
  "
```
